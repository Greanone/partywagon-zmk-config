## config/boards/shields/partywagon/Kconfig.defconfig
```kconfig
# Copyright (c) 2020 The ZMK Contributors
# SPDX-License-Identifier: MIT

if SHIELD_PARTYWAGON

config ZMK_KEYBOARD_NAME
    default "Partywagon"

endif
```

## config/boards/shields/partywagon/Kconfig.shield
```kconfig
# Copyright (c) 2020 The ZMK Contributors
# SPDX-License-Identifier: MIT

config SHIELD_PARTYWAGON
    def_bool $(shields_list_contains,partywagon)
```
